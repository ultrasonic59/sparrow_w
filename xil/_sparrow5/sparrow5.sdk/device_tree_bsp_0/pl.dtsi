/*
 * CAUTION: This file is automatically generated by Xilinx.
 * Version:  
 * Today is: Sat Jul 29 14:31:28 2017
*/


/ {
	amba_pl: amba_pl {
		#address-cells = <1>;
		#size-cells = <1>;
		compatible = "simple-bus";
		ranges ;
		axi_udef_0: axi_udef@43c00000 {
			compatible = "xlnx,axi-udef-1.0";
			interrupt-parent = <&intc>;
			interrupts = <0 29 4>;
			reg = <0x43c00000 0x10000 0x43c10000 0x10000>;
			xlnx,intr-active-state = <0xFFFFFFFF>;
			xlnx,intr-sensitivity = <0xFFFFFFFF>;
			xlnx,irq-active-state = <0x1>;
			xlnx,irq-sensitivity = <0x1>;
			xlnx,num-of-intr = <0x1>;
			xlnx,s-axi-intr-addr-width = <0x5>;
			xlnx,s-axi-intr-data-width = <0x20>;
		};
	};
};
